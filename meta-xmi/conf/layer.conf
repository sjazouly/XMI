## meta-xmi/conf/layer.conf
```bitbake
# We have a conf and classes directory, add to BBPATH
BBPATH .= ":${LAYERDIR}"

# We have recipes-* directories, add to BBFILES
BBFILES += "${LAYERDIR}/recipes-*/*/*.bb \
	${LAYERDIR}/recipes-*/*/*.bbappend"

BBFILE_COLLECTIONS += "meta-xmi"
BBFILE_PATTERN_meta-xmi= "^${LAYERDIR}/"
BBFILE_PRIORITY_meta-xmi = "50"

LAYERDEPENDS_meta-xmi = "\
    core \
    fsl-sdk-release \
    openembedded-layer \
    qt6-layer \
"
LAYERSERIES_COMPAT_meta-xmi = "langdale mickledore nanbield "

# KERNEL_DEVICETREE:append:fdc-mamabear = " \
# 	freescale/fdc-mamabear-imx219.dtb \
# "
```
